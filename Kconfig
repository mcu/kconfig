## Kconfig
```kconfig
###############################################################################
# SPDX-License-Identifier: GPL-3.0-or-later
###############################################################################

mainmenu "MCU App Configuration"

  menu "Application"
    source "application/Kconfig"
  endmenu

  menu "Compiler"
    source "scripts/menu/compiler/ChoiceCDebugLevel"
    source "scripts/menu/compiler/ChoiceCLanguageStandard"
    source "scripts/menu/compiler/ChoiceCOptimizationLevel"
    source "scripts/menu/compiler/FlagCDataSections"
    source "scripts/menu/compiler/FlagCFunctionSections"
    source "scripts/menu/compiler/FlagCStackUsage"
    source "scripts/menu/compiler/FlagCWarnAll"
    source "scripts/menu/compiler/FlagCWarnError"
    source "scripts/menu/compiler/FlagCWarnExtra"
    source "scripts/menu/compiler/FlagCWarnNoUnusedParameter"
    source "scripts/menu/compiler/FlagCWarnSwitchDefault"
    source "scripts/menu/compiler/FlagCWarnSwitchEnum"
    source "scripts/menu/compiler/FlagUsePrintfFloat"
    source "scripts/menu/compiler/FlagUseScanfFloat"
  endmenu

  menu "Components"
    source "components/Kconfig"
  endmenu

###############################################################################
```

## application/Kconfig
```kconfig
###############################################################################
# SPDX-License-Identifier: GPL-3.0-or-later
###############################################################################

config APP_BLINK_LED_DELAY
  int "Blink led delay (Milliseconds)"
  default 500
  range 0 10000

###############################################################################
```

## components/Kconfig
```kconfig
###############################################################################
# SPDX-License-Identifier: GPL-3.0-or-later
###############################################################################

source "components/freertos-10.0.1/Kconfig"

###############################################################################
```

## components/freertos-10.0.1/Kconfig
```kconfig
###############################################################################
# SPDX-License-Identifier: GPL-3.0-or-later
###############################################################################

menu "FreeRTOS"

  config FREERTOS_TICK_RATE_HZ
    int "Tick rate (Hz)"
    default 1000
    range 1 1000

endmenu

###############################################################################
```
